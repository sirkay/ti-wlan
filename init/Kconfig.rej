## init/Kconfig.rej
```kconfig
--- init/Kconfig	2011-05-17 17:00:58.985449874 +1000
+++ init/Kconfig	2011-05-17 17:01:14.592115760 +1000
@@ -561,7 +574,7 @@
 
 menuconfig CGROUP_SCHED
 	bool "Group CPU scheduler"
-	depends on EXPERIMENTAL && CGROUPS
+	depends on EXPERIMENTAL && CGROUPS && !SCHED_BFS
 	default n
 	help
 	  This feature lets CPU scheduler recognize task groups and control CPU
```

## lib/Kconfig.debug.rej
```kconfig
--- lib/Kconfig.debug	2009-12-03 21:40:10.000000000 +1100
+++ lib/Kconfig.debug	2010-12-16 16:07:44.253620756 +1100
@@ -718,7 +718,7 @@
 
 config RCU_TORTURE_TEST
 	tristate "torture tests for RCU"
-	depends on DEBUG_KERNEL
+	depends on DEBUG_KERNEL && !SCHED_BFS
 	default n
 	help
 	  This option provides a kernel module that runs torture tests
```
